## sdlp/Kconfig
```kconfig
#
# SDLP Network Device Configuration
#
config SDLP
    tristate "SDLP (Space Data Link Protocol) support"
    depends on TTY
    ---help---
        Turn this on if you want to use CCSDS 133.#### Space Data Link Protocol with TM
        Synchronization for communicating with a TTY or similar device

# Add other necessary config options
```

## slspp/Kconfig
```kconfig
#
# SLSSP Network Device Configuration
#
config SLSSP
    tristate "SLSSP (serial line) support"
    depends on TTY
    ---help---
      Turn this on if you want to use the Adamant Aerospace Elysium's strange
      serial protocol for sending SPP packets through a nice network device

# Add other config options as needed
```

## spp/net/spp/Kconfig
```kconfig
#
# Kernel Config for SPP in Linux
#

menuconfig SPP
    depends on NET
    bool "Space Packet Protocol support"
    help
      If you want to use the CCSDS 133.0-B-1 specification, you'll know to say yes here.
      Made with love by Jacob Holtom and his team of crackpot engineers.
```
